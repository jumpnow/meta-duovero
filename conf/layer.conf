## conf/layer.conf
```bitbake
# We have a conf and classes directory, append to BBPATH
BBPATH .= ":${LAYERDIR}"

# We have a recipes directory, add to BBFILES
BBFILES += "${LAYERDIR}/recipes*/*/*.bb ${LAYERDIR}/recipes*/*/*.bbappend ${LAYERDIR}/images/*.bb"

BBFILE_COLLECTIONS += "meta-duovero"
BBFILE_PATTERN_meta-duovero := "^${LAYERDIR}/"
BBFILE_PRIORITY_meta-duovero = "16"

LAYERSERIES_COMPAT_meta-duovero = "gatesgarth"
```

## conf/local.conf.sample
```bitbake
# Local configuration for meta-duovero images
# Yocto Project 2.3 Poky distribution [pyro] branch
# This is a sysvinit system

LICENSE_FLAGS_WHITELIST = "commercial"

DISTRO_FEATURES = "ext2 usbhost ${DISTRO_FEATURES_LIBC}"

DISTRO_FEATURES_BACKFILL_CONSIDERED += "pulseaudio opengl"

PREFERRED_PROVIDER_jpeg = "libjpeg-turbo"

PREFERRED_PROVIDER_udev = "eudev"
VIRTUAL-RUNTIME_init_manager = "sysvinit"

PREFERRED_VERSION_linux-stable = "4.9.%"

MACHINE = "duovero"

#DL_DIR = "${HOME}/oe-sources"

#SSTATE_DIR = "/oe7/duo/sstate-cache"

#TMPDIR = "/oe7/duo/tmp-pyro"

DISTRO = "poky"

PACKAGE_CLASSES = "package_ipk"

# i686 or x86_64
SDKMACHINE = "x86_64"

EXTRA_IMAGE_FEATURES = "debug-tweaks"

USER_CLASSES = "image-mklibs image-prelink"

PATCHRESOLVE = "noop"

RM_OLD_IMAGE = "1"

INHERIT += "rm_work"

CONF_VERSION = "1"
```

## conf/machine/duovero.conf
```bitbake
#@TYPE: Machine
#@NAME: DuoVero
#@DESCRIPTION: Machine configuration for the Gumstix DuoVero

SOC_FAMILY = "omap4"
TARGET_ARCH = "arm"

DEFAULTTUNE ?= "cortexa9hf-neon"

require conf/machine/include/soc-family.inc
require conf/machine/include/arm/armv7a/tune-cortexa9.inc

PREFERRED_PROVIDER_virtual/kernel = "linux-stable"
KERNEL_IMAGETYPE = "zImage"

PREFERRED_PROVIDER_virtual/bootloader = "u-boot"
PREFERRED_PROVIDER_u-boot = "u-boot"

UBOOT_ENTRYPOINT = "0x80008000"
UBOOT_LOADADDRESS = "0x80008000"
UBOOT_MACHINE = "duovero_config"
BOOTENV_SIZE = "0x20000"

EXTRA_IMAGEDEPENDS += "u-boot"

SERIAL_CONSOLES = "115200;ttyO2"

IMAGE_FSTYPES = "tar.xz"

MACHINE_ESSENTIAL_EXTRA_RDEPENDS = "kernel-image kernel-devicetree kernel-modules"

MACHINE_FEATURES = "ext2 serial usbhost vfat"
```
